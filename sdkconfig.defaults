## sdkconfig.defaults
```kconfig
# --- toolchain / codegen ---
CONFIG_COMPILER_STACK_CHECK=y
CONFIG_COMPILER_STACK_CHECK_MODE_STRONG=y
CONFIG_COMPILER_CXX_EXCEPTIONS=
CONFIG_COMPILER_CXX_RTTI=
CONFIG_COMPILER_WARN_WRITE_STRINGS=y
CONFIG_COMPILER_WARN_WRITE_STRINGS_WRITING_TO_CONST=y

CONFIG_APP_REPRODUCIBLE_BUILD=y
CONFIG_APP_COMPILE_TIME_DATE=n
CONFIG_BOOTLOADER_COMPILE_TIME_DATE=n

# --- TinyUSB: HID only ---
CONFIG_TINYUSB_HID_COUNT=1
CONFIG_TINYUSB_MIDI_COUNT=0
CONFIG_TINYUSB_VENDOR_COUNT=0
CONFIG_TINYUSB_CDC_ENABLED=n
CONFIG_TINYUSB_MSC_ENABLED=n
CONFIG_TINYUSB_DFU_MODE_NONE=y
CONFIG_TINYUSB_NET_MODE_NONE=y

# --- watchdog: on, panics ---
CONFIG_ESP_TASK_WDT_EN=y
CONFIG_ESP_TASK_WDT_INIT=y
CONFIG_ESP_TASK_WDT_PANIC=y
CONFIG_ESP_INT_WDT=y
CONFIG_BOOTLOADER_WDT_ENABLE=y
CONFIG_BOOTLOADER_WDT_TIME_MS=9000

# --- bootloader / flash write safety ---
CONFIG_BOOTLOADER_REGION_PROTECTION_ENABLE=y
CONFIG_SPI_FLASH_DANGEROUS_WRITE_ABORTS=y

# --- partitions: shared 4 MB table on every board ---
CONFIG_PARTITION_TABLE_CUSTOM=y
CONFIG_PARTITION_TABLE_CUSTOM_FILENAME="partitions.csv"
CONFIG_PARTITION_TABLE_OFFSET=0x8000

# --- hardware crypto accelerators ---
CONFIG_MBEDTLS_HARDWARE_SHA=y
CONFIG_MBEDTLS_HARDWARE_AES=y
CONFIG_MBEDTLS_HARDWARE_MPI=y

# --- radios off ---
CONFIG_BT_ENABLED=n
CONFIG_ESP_WIFI_ENABLED=n
CONFIG_ESP_COEX_SW_COEXIST_ENABLE=n

CONFIG_SPIRAM=n

# N16R8 flash config
# --- 16 MB quad flash ---
CONFIG_ESPTOOLPY_FLASHMODE_QIO=y
CONFIG_ESPTOOLPY_FLASHFREQ_80M=y
CONFIG_ESPTOOLPY_FLASHSIZE_16MB=y
CONFIG_ESPTOOLPY_FLASHSIZE_DETECT=n
CONFIG_ESPTOOLPY_OCT_FLASH=n
CONFIG_ESPTOOLPY_FLASH_SAMPLE_MODE_STR=y
CONFIG_ESPTOOLPY_AFTER_RESET=y

# supermini flash config
#CONFIG_ESPTOOLPY_FLASHMODE_QIO=y
#CONFIG_ESPTOOLPY_FLASHFREQ_80M=y
#CONFIG_ESPTOOLPY_FLASHSIZE_4MB=y
#CONFIG_ESPTOOLPY_FLASHSIZE_DETECT=n
#CONFIG_ESPTOOLPY_OCT_FLASH=n
```

## sdkconfig.defaults.esp32s3
```kconfig
CONFIG_IDF_TARGET="esp32s3"

# --- CPU ---
CONFIG_ESP_DEFAULT_CPU_FREQ_MHZ_240=y

# --- memory protection ---
CONFIG_ESP_SYSTEM_MEMPROT_FEATURE=y
CONFIG_ESP_SYSTEM_HW_STACK_GUARD=y
```
